## drivers/misc/mediatek/sound/Kconfig
```kconfig
config MT_SND_SOC_6580
    bool "MT_SND_SOC_6580"
	default n
	help
        If you say Y, enable MT_SND_SOC_6580_driver.
        
config MTK_SOUND_DRV
  bool CONFIG_MTK_SOUND_DRV
  default n
  help
    CONFIG_MTK_SOUND_DRV        
```
